## config/boards/shields/broccoli_board/Kconfig.defconfig
```kconfig
if SHIELD_BROCCOLI_BOARD

config ZMK_KEYBOARD_NAME
    default "Broccoli Board"

endif
```

## config/west.yml
```yaml
manifest:
  defaults:
    revision: v0.3
  remotes:
    - name: zmkfirmware
      url-base: https://github.com/zmkfirmware
  projects:
    - name: zmk
      remote: zmkfirmware
      revision: main
      import: app/west.yml
  self:
    path: config
```

## firmware/boards/shields/broccoli_board/Kconfig.shield
```kconfig
config SHIELD_BROCCOLI_BOARD
    def_bool $(shields_list_contains,broccoli_board)
    
```
