## firmware/build/Kconfig/Kconfig.modules
```kconfig
menu "acpica (F:/OneDrive/Desktop/cloned repos/Broccoli-board/zmk-workspace/modules/lib/acpica)"
osource "$(ZEPHYR_ACPICA_KCONFIG)"
config ZEPHYR_ACPICA_MODULE
	bool
	default y
endmenu
menu "cmsis (F:/OneDrive/Desktop/cloned repos/Broccoli-board/zmk-workspace/modules/hal/cmsis)"
osource "$(ZEPHYR_CMSIS_KCONFIG)"
config ZEPHYR_CMSIS_MODULE
	bool
	default y
endmenu
menu "cmsis-dsp (F:/OneDrive/Desktop/cloned repos/Broccoli-board/zmk-workspace/modules/lib/cmsis-dsp)"
osource "$(ZEPHYR_CMSIS_DSP_KCONFIG)"
config ZEPHYR_CMSIS_DSP_MODULE
	bool
	default y
endmenu
menu "cmsis-nn (F:/OneDrive/Desktop/cloned repos/Broccoli-board/zmk-workspace/modules/lib/cmsis-nn)"
osource "$(ZEPHYR_CMSIS_NN_KCONFIG)"
config ZEPHYR_CMSIS_NN_MODULE
	bool
	default y
endmenu
menu "fatfs (F:/OneDrive/Desktop/cloned repos/Broccoli-board/zmk-workspace/modules/fs/fatfs)"
osource "$(ZEPHYR_FATFS_KCONFIG)"
config ZEPHYR_FATFS_MODULE
	bool
	default y
endmenu
config ZEPHYR_ADI_MODULE
	bool
	default y
config ZEPHYR_ALTERA_MODULE
	bool
	default y
menu "hal_ambiq (F:/OneDrive/Desktop/cloned repos/Broccoli-board/zmk-workspace/modules/hal/ambiq)"
osource "$(ZEPHYR_HAL_AMBIQ_KCONFIG)"
config ZEPHYR_HAL_AMBIQ_MODULE
	bool
	default y
endmenu
config ZEPHYR_ATMEL_MODULE
	bool
	default y
menu "hal_espressif (F:/OneDrive/Desktop/cloned repos/Broccoli-board/zmk-workspace/modules/hal/espressif)"
osource "F:/OneDrive/Desktop/cloned repos/Broccoli-board/zmk-workspace/modules/hal/espressif/zephyr/Kconfig"
config ZEPHYR_HAL_ESPRESSIF_MODULE
	bool
	default y

config ZEPHYR_HAL_ESPRESSIF_MODULE_BLOBS
	bool
endmenu
menu "hal_ethos_u (F:/OneDrive/Desktop/cloned repos/Broccoli-board/zmk-workspace/modules/hal/ethos_u)"
osource "$(ZEPHYR_HAL_ETHOS_U_KCONFIG)"
config ZEPHYR_HAL_ETHOS_U_MODULE
	bool
	default y
endmenu
menu "hal_gigadevice (F:/OneDrive/Desktop/cloned repos/Broccoli-board/zmk-workspace/modules/hal/gigadevice)"
osource "$(ZEPHYR_HAL_GIGADEVICE_KCONFIG)"
config ZEPHYR_HAL_GIGADEVICE_MODULE
	bool
	default y
endmenu
menu "hal_infineon (F:/OneDrive/Desktop/cloned repos/Broccoli-board/zmk-workspace/modules/hal/infineon)"
osource "$(ZEPHYR_HAL_INFINEON_KCONFIG)"
config ZEPHYR_HAL_INFINEON_MODULE
	bool
	default y

config ZEPHYR_HAL_INFINEON_MODULE_BLOBS
	bool
endmenu
menu "hal_intel (F:/OneDrive/Desktop/cloned repos/Broccoli-board/zmk-workspace/modules/hal/intel)"
osource "F:/OneDrive/Desktop/cloned repos/Broccoli-board/zmk-workspace/modules/hal/intel/zephyr/Kconfig"
config ZEPHYR_HAL_INTEL_MODULE
	bool
	default y
endmenu
config ZEPHYR_MICROCHIP_MODULE
	bool
	default y
menu "hal_nordic (F:/OneDrive/Desktop/cloned repos/Broccoli-board/zmk-workspace/modules/hal/nordic)"
osource "$(ZEPHYR_HAL_NORDIC_KCONFIG)"
config ZEPHYR_HAL_NORDIC_MODULE
	bool
	default y

config ZEPHYR_HAL_NORDIC_MODULE_BLOBS
	bool
endmenu
config ZEPHYR_NUVOTON_MODULE
	bool
	default y
menu "hal_nxp (F:/OneDrive/Desktop/cloned repos/Broccoli-board/zmk-workspace/modules/hal/nxp)"
osource "$(ZEPHYR_HAL_NXP_KCONFIG)"
config ZEPHYR_HAL_NXP_MODULE
	bool
	default y

config ZEPHYR_HAL_NXP_MODULE_BLOBS
	bool
endmenu
config ZEPHYR_OPENISA_MODULE
	bool
	default y
config ZEPHYR_QUICKLOGIC_MODULE
	bool
	default y
config ZEPHYR_HAL_RENESAS_MODULE
	bool
	default y

config ZEPHYR_HAL_RENESAS_MODULE_BLOBS
	bool
menu "hal_rpi_pico (F:/OneDrive/Desktop/cloned repos/Broccoli-board/zmk-workspace/modules/hal/rpi_pico)"
osource "$(ZEPHYR_HAL_RPI_PICO_KCONFIG)"
config ZEPHYR_HAL_RPI_PICO_MODULE
	bool
	default y
endmenu
menu "hal_silabs (F:/OneDrive/Desktop/cloned repos/Broccoli-board/zmk-workspace/modules/hal/silabs)"
osource "$(ZEPHYR_HAL_SILABS_KCONFIG)"
config ZEPHYR_HAL_SILABS_MODULE
	bool
	default y

config ZEPHYR_HAL_SILABS_MODULE_BLOBS
	bool
endmenu
menu "hal_st (F:/OneDrive/Desktop/cloned repos/Broccoli-board/zmk-workspace/modules/hal/st)"
osource "$(ZEPHYR_HAL_ST_KCONFIG)"
config ZEPHYR_HAL_ST_MODULE
	bool
	default y
endmenu
config ZEPHYR_HAL_STM32_MODULE
	bool
	default y

config ZEPHYR_HAL_STM32_MODULE_BLOBS
	bool
menu "hal_tdk (F:/OneDrive/Desktop/cloned repos/Broccoli-board/zmk-workspace/modules/hal/tdk)"
osource "$(ZEPHYR_HAL_TDK_KCONFIG)"
config ZEPHYR_HAL_TDK_MODULE
	bool
	default y
endmenu
menu "hal_telink (F:/OneDrive/Desktop/cloned repos/Broccoli-board/zmk-workspace/modules/hal/telink)"
osource "F:/OneDrive/Desktop/cloned repos/Broccoli-board/zmk-workspace/modules/hal/telink/Kconfig"
config ZEPHYR_HAL_TELINK_MODULE
	bool
	default y
endmenu
config ZEPHYR_TI_MODULE
	bool
	default y
menu "hal_wch (F:/OneDrive/Desktop/cloned repos/Broccoli-board/zmk-workspace/modules/hal/wch)"
osource "$(ZEPHYR_HAL_WCH_KCONFIG)"
config ZEPHYR_HAL_WCH_MODULE
	bool
	default y
endmenu
config ZEPHYR_HAL_WURTHELEKTRONIK_MODULE
	bool
	default y
config ZEPHYR_XTENSA_MODULE
	bool
	default y
menu "hostap (F:/OneDrive/Desktop/cloned repos/Broccoli-board/zmk-workspace/modules/lib/hostap)"
osource "$(ZEPHYR_HOSTAP_KCONFIG)"
config ZEPHYR_HOSTAP_MODULE
	bool
	default y
endmenu
menu "liblc3 (F:/OneDrive/Desktop/cloned repos/Broccoli-board/zmk-workspace/modules/lib/liblc3)"
osource "$(ZEPHYR_LIBLC3_KCONFIG)"
config ZEPHYR_LIBLC3_MODULE
	bool
	default y
endmenu
config ZEPHYR_LIBMCTP_MODULE
	bool
	default y
config ZEPHYR_LIBMETAL_MODULE
	bool
	default y
menu "littlefs (F:/OneDrive/Desktop/cloned repos/Broccoli-board/zmk-workspace/modules/fs/littlefs)"
osource "$(ZEPHYR_LITTLEFS_KCONFIG)"
config ZEPHYR_LITTLEFS_MODULE
	bool
	default y
endmenu
menu "loramac-node (F:/OneDrive/Desktop/cloned repos/Broccoli-board/zmk-workspace/modules/lib/loramac-node)"
osource "$(ZEPHYR_LORAMAC_NODE_KCONFIG)"
config ZEPHYR_LORAMAC_NODE_MODULE
	bool
	default y
endmenu
menu "lvgl (F:/OneDrive/Desktop/cloned repos/Broccoli-board/zmk-workspace/modules/lib/gui/lvgl)"
osource "F:/OneDrive/Desktop/cloned repos/Broccoli-board/zmk-workspace/modules/lib/gui/lvgl/zephyr/Kconfig"
config ZEPHYR_LVGL_MODULE
	bool
	default y
endmenu
menu "mbedtls (F:/OneDrive/Desktop/cloned repos/Broccoli-board/zmk-workspace/modules/crypto/mbedtls)"
osource "$(ZEPHYR_MBEDTLS_KCONFIG)"
config ZEPHYR_MBEDTLS_MODULE
	bool
	default y
endmenu
config ZEPHYR_MCUBOOT_MODULE
	bool
	default y
config ZEPHYR_MIPI_SYS_T_MODULE
	bool
	default y
menu "nrf_wifi (F:/OneDrive/Desktop/cloned repos/Broccoli-board/zmk-workspace/modules/lib/nrf_wifi)"
osource "$(ZEPHYR_NRF_WIFI_KCONFIG)"
config ZEPHYR_NRF_WIFI_MODULE
	bool
	default y

config ZEPHYR_NRF_WIFI_MODULE_BLOBS
	bool
endmenu
config ZEPHYR_OPEN_AMP_MODULE
	bool
	default y
menu "openthread (F:/OneDrive/Desktop/cloned repos/Broccoli-board/zmk-workspace/modules/lib/openthread)"
osource "$(ZEPHYR_OPENTHREAD_KCONFIG)"
config ZEPHYR_OPENTHREAD_MODULE
	bool
	default y
endmenu
menu "percepio (F:/OneDrive/Desktop/cloned repos/Broccoli-board/zmk-workspace/modules/debug/percepio)"
osource "F:/OneDrive/Desktop/cloned repos/Broccoli-board/zmk-workspace/modules/debug/percepio/zephyr/Kconfig"
config ZEPHYR_PERCEPIO_MODULE
	bool
	default y
endmenu
menu "picolibc (F:/OneDrive/Desktop/cloned repos/Broccoli-board/zmk-workspace/modules/lib/picolibc)"
osource "F:/OneDrive/Desktop/cloned repos/Broccoli-board/zmk-workspace/modules/lib/picolibc/zephyr/Kconfig"
config ZEPHYR_PICOLIBC_MODULE
	bool
	default y
endmenu
menu "segger (F:/OneDrive/Desktop/cloned repos/Broccoli-board/zmk-workspace/modules/debug/segger)"
osource "$(ZEPHYR_SEGGER_KCONFIG)"
config ZEPHYR_SEGGER_MODULE
	bool
	default y
endmenu
config ZEPHYR_TINYCRYPT_MODULE
	bool
	default y
menu "trusted-firmware-a (F:/OneDrive/Desktop/cloned repos/Broccoli-board/zmk-workspace/modules/tee/tf-a/trusted-firmware-a)"
osource "$(ZEPHYR_TRUSTED_FIRMWARE_A_KCONFIG)"
config ZEPHYR_TRUSTED_FIRMWARE_A_MODULE
	bool
	default y
endmenu
menu "trusted-firmware-m (F:/OneDrive/Desktop/cloned repos/Broccoli-board/zmk-workspace/modules/tee/tf-m/trusted-firmware-m)"
osource "$(ZEPHYR_TRUSTED_FIRMWARE_M_KCONFIG)"
config ZEPHYR_TRUSTED_FIRMWARE_M_MODULE
	bool
	default y
endmenu
menu "uoscore-uedhoc (F:/OneDrive/Desktop/cloned repos/Broccoli-board/zmk-workspace/modules/lib/uoscore-uedhoc)"
osource "$(ZEPHYR_UOSCORE_UEDHOC_KCONFIG)"
config ZEPHYR_UOSCORE_UEDHOC_MODULE
	bool
	default y
endmenu
menu "zcbor (F:/OneDrive/Desktop/cloned repos/Broccoli-board/zmk-workspace/modules/lib/zcbor)"
osource "$(ZEPHYR_ZCBOR_KCONFIG)"
config ZEPHYR_ZCBOR_MODULE
	bool
	default y
endmenu
menu "module (F:/OneDrive/Desktop/cloned repos/Broccoli-board/zmk-workspace/zmk.git/app/module)"
osource "F:/OneDrive/Desktop/cloned repos/Broccoli-board/zmk-workspace/zmk.git/app/module/Kconfig"
config ZEPHYR_MODULE_MODULE
	bool
	default y
endmenu
config ZEPHYR_KEYMAP_MODULE_MODULE
	bool
	default y
config ZEPHYR_NRF_HW_MODELS_MODULE
	bool
	default y
```

## firmware/build/Kconfig/arch/Kconfig
```kconfig
# Load Zephyr Arch Kconfig descriptions.
osource "F:/OneDrive/Desktop/cloned repos/Broccoli-board/zmk-workspace/zephyr/arch/x86/Kconfig"
osource "F:/OneDrive/Desktop/cloned repos/Broccoli-board/zmk-workspace/zephyr/arch/xtensa/Kconfig"
osource "F:/OneDrive/Desktop/cloned repos/Broccoli-board/zmk-workspace/zephyr/arch/sparc/Kconfig"
osource "F:/OneDrive/Desktop/cloned repos/Broccoli-board/zmk-workspace/zephyr/arch/riscv/Kconfig"
osource "F:/OneDrive/Desktop/cloned repos/Broccoli-board/zmk-workspace/zephyr/arch/posix/Kconfig"
osource "F:/OneDrive/Desktop/cloned repos/Broccoli-board/zmk-workspace/zephyr/arch/nios2/Kconfig"
osource "F:/OneDrive/Desktop/cloned repos/Broccoli-board/zmk-workspace/zephyr/arch/mips/Kconfig"
osource "F:/OneDrive/Desktop/cloned repos/Broccoli-board/zmk-workspace/zephyr/arch/arm64/Kconfig"
osource "F:/OneDrive/Desktop/cloned repos/Broccoli-board/zmk-workspace/zephyr/arch/arm/Kconfig"
osource "F:/OneDrive/Desktop/cloned repos/Broccoli-board/zmk-workspace/zephyr/arch/arc/Kconfig"
```

## firmware/build/Kconfig/boards/Kconfig
```kconfig
# Load Zephyr board Kconfig descriptions.
osource "F:/OneDrive/Desktop/cloned repos/Broccoli-board/zmk-workspace/zmk.git/app/module/boards/nicekeyboards/nice_nano/Kconfig"
osource "F:/OneDrive/Desktop/cloned repos/Broccoli-board/zmk-workspace/zmk.git/app/boards/nicekeyboards/nice_nano/Kconfig"
```

## firmware/build/Kconfig/boards/Kconfig.defconfig
```kconfig
# Load Zephyr board defconfig descriptions.
osource "F:/OneDrive/Desktop/cloned repos/Broccoli-board/zmk-workspace/zmk.git/app/module/boards/nicekeyboards/nice_nano/Kconfig.defconfig"
osource "F:/OneDrive/Desktop/cloned repos/Broccoli-board/zmk-workspace/zmk.git/app/boards/nicekeyboards/nice_nano/Kconfig.defconfig"
```

## firmware/build/Kconfig/boards/Kconfig.nice_nano
```kconfig
# Load board Kconfig descriptions.
osource "F:/OneDrive/Desktop/cloned repos/Broccoli-board/zmk-workspace/zmk.git/app/module/boards/nicekeyboards/nice_nano/Kconfig.nice_nano"
osource "F:/OneDrive/Desktop/cloned repos/Broccoli-board/zmk-workspace/zmk.git/app/boards/nicekeyboards/nice_nano/Kconfig.nice_nano"
```

## firmware/build/Kconfig/boards/Kconfig.sysbuild
```kconfig
# Load Sysbuild board Kconfig descriptions.
osource "F:/OneDrive/Desktop/cloned repos/Broccoli-board/zmk-workspace/zmk.git/app/module/boards/nicekeyboards/nice_nano/Kconfig.sysbuild"
osource "F:/OneDrive/Desktop/cloned repos/Broccoli-board/zmk-workspace/zmk.git/app/boards/nicekeyboards/nice_nano/Kconfig.sysbuild"
```
