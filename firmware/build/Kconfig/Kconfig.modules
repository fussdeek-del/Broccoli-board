## firmware/build/Kconfig/soc/Kconfig
```kconfig
# Load Zephyr SoC Kconfig descriptions.
osource "F:/OneDrive/Desktop/cloned repos/Broccoli-board/zmk-workspace/zephyr/soc/xlnx/zynqmp/Kconfig"
osource "F:/OneDrive/Desktop/cloned repos/Broccoli-board/zmk-workspace/zephyr/soc/xlnx/zynq7000/Kconfig"
osource "F:/OneDrive/Desktop/cloned repos/Broccoli-board/zmk-workspace/zephyr/soc/xen/Kconfig"
osource "F:/OneDrive/Desktop/cloned repos/Broccoli-board/zmk-workspace/zephyr/soc/wch/ch32v/Kconfig"
osource "F:/OneDrive/Desktop/cloned repos/Broccoli-board/zmk-workspace/zephyr/soc/ti/simplelink/Kconfig"
osource "F:/OneDrive/Desktop/cloned repos/Broccoli-board/zmk-workspace/zephyr/soc/ti/lm3s6965/Kconfig"
osource "F:/OneDrive/Desktop/cloned repos/Broccoli-board/zmk-workspace/zephyr/soc/ti/k3/Kconfig"
osource "F:/OneDrive/Desktop/cloned repos/Broccoli-board/zmk-workspace/zephyr/soc/telink/tlsr/Kconfig"
osource "F:/OneDrive/Desktop/cloned repos/Broccoli-board/zmk-workspace/zephyr/soc/starfive/jh71xx/Kconfig"
osource "F:/OneDrive/Desktop/cloned repos/Broccoli-board/zmk-workspace/zephyr/soc/st/stm32/Kconfig"
osource "F:/OneDrive/Desktop/cloned repos/Broccoli-board/zmk-workspace/zephyr/soc/snps/qemu_arc/Kconfig"
osource "F:/OneDrive/Desktop/cloned repos/Broccoli-board/zmk-workspace/zephyr/soc/snps/nsim/arc_v/Kconfig"
osource "F:/OneDrive/Desktop/cloned repos/Broccoli-board/zmk-workspace/zephyr/soc/snps/nsim/arc_classic/Kconfig"
osource "F:/OneDrive/Desktop/cloned repos/Broccoli-board/zmk-workspace/zephyr/soc/snps/hsdk4xd/Kconfig"
osource "F:/OneDrive/Desktop/cloned repos/Broccoli-board/zmk-workspace/zephyr/soc/snps/hsdk/Kconfig"
osource "F:/OneDrive/Desktop/cloned repos/Broccoli-board/zmk-workspace/zephyr/soc/snps/emsk/Kconfig"
osource "F:/OneDrive/Desktop/cloned repos/Broccoli-board/zmk-workspace/zephyr/soc/snps/emsdp/Kconfig"
osource "F:/OneDrive/Desktop/cloned repos/Broccoli-board/zmk-workspace/zephyr/soc/snps/arc_iot/Kconfig"
osource "F:/OneDrive/Desktop/cloned repos/Broccoli-board/zmk-workspace/zephyr/soc/silabs/Kconfig"
osource "F:/OneDrive/Desktop/cloned repos/Broccoli-board/zmk-workspace/zephyr/soc/sifive/sifive_freedom/Kconfig"
osource "F:/OneDrive/Desktop/cloned repos/Broccoli-board/zmk-workspace/zephyr/soc/sensry/Kconfig"
osource "F:/OneDrive/Desktop/cloned repos/Broccoli-board/zmk-workspace/zephyr/soc/rockchip/Kconfig"
osource "F:/OneDrive/Desktop/cloned repos/Broccoli-board/zmk-workspace/zephyr/soc/renode/riscv_virtual/Kconfig"
osource "F:/OneDrive/Desktop/cloned repos/Broccoli-board/zmk-workspace/zephyr/soc/renode/cortex_r8_virtual/Kconfig"
osource "F:/OneDrive/Desktop/cloned repos/Broccoli-board/zmk-workspace/zephyr/soc/renesas/smartbond/Kconfig"
osource "F:/OneDrive/Desktop/cloned repos/Broccoli-board/zmk-workspace/zephyr/soc/renesas/rzt2m/Kconfig"
osource "F:/OneDrive/Desktop/cloned repos/Broccoli-board/zmk-workspace/zephyr/soc/renesas/rz/Kconfig"
osource "F:/OneDrive/Desktop/cloned repos/Broccoli-board/zmk-workspace/zephyr/soc/renesas/rcar/Kconfig"
osource "F:/OneDrive/Desktop/cloned repos/Broccoli-board/zmk-workspace/zephyr/soc/renesas/ra/Kconfig"
osource "F:/OneDrive/Desktop/cloned repos/Broccoli-board/zmk-workspace/zephyr/soc/realtek/ec/Kconfig"
osource "F:/OneDrive/Desktop/cloned repos/Broccoli-board/zmk-workspace/zephyr/soc/raspberrypi/rpi_pico/Kconfig"
osource "F:/OneDrive/Desktop/cloned repos/Broccoli-board/zmk-workspace/zephyr/soc/quicklogic/eos_s3/Kconfig"
osource "F:/OneDrive/Desktop/cloned repos/Broccoli-board/zmk-workspace/zephyr/soc/qemu/virt_riscv/Kconfig"
osource "F:/OneDrive/Desktop/cloned repos/Broccoli-board/zmk-workspace/zephyr/soc/qemu/malta/Kconfig"
osource "F:/OneDrive/Desktop/cloned repos/Broccoli-board/zmk-workspace/zephyr/soc/openisa/rv32m1/Kconfig"
osource "F:/OneDrive/Desktop/cloned repos/Broccoli-board/zmk-workspace/zephyr/soc/nxp/s32/Kconfig"
osource "F:/OneDrive/Desktop/cloned repos/Broccoli-board/zmk-workspace/zephyr/soc/nxp/rw/Kconfig"
osource "F:/OneDrive/Desktop/cloned repos/Broccoli-board/zmk-workspace/zephyr/soc/nxp/mcx/Kconfig"
osource "F:/OneDrive/Desktop/cloned repos/Broccoli-board/zmk-workspace/zephyr/soc/nxp/lpc/Kconfig"
osource "F:/OneDrive/Desktop/cloned repos/Broccoli-board/zmk-workspace/zephyr/soc/nxp/layerscape/Kconfig"
osource "F:/OneDrive/Desktop/cloned repos/Broccoli-board/zmk-workspace/zephyr/soc/nxp/kinetis/Kconfig"
osource "F:/OneDrive/Desktop/cloned repos/Broccoli-board/zmk-workspace/zephyr/soc/nxp/imxrt/Kconfig"
osource "F:/OneDrive/Desktop/cloned repos/Broccoli-board/zmk-workspace/zephyr/soc/nxp/imx/Kconfig"
osource "F:/OneDrive/Desktop/cloned repos/Broccoli-board/zmk-workspace/zephyr/soc/nuvoton/numicro/Kconfig"
osource "F:/OneDrive/Desktop/cloned repos/Broccoli-board/zmk-workspace/zephyr/soc/nuvoton/numaker/Kconfig"
osource "F:/OneDrive/Desktop/cloned repos/Broccoli-board/zmk-workspace/zephyr/soc/nuvoton/npcx/Kconfig"
osource "F:/OneDrive/Desktop/cloned repos/Broccoli-board/zmk-workspace/zephyr/soc/nuvoton/npcm/Kconfig"
osource "F:/OneDrive/Desktop/cloned repos/Broccoli-board/zmk-workspace/zephyr/soc/nordic/Kconfig"
osource "F:/OneDrive/Desktop/cloned repos/Broccoli-board/zmk-workspace/zephyr/soc/neorv32/Kconfig"
osource "F:/OneDrive/Desktop/cloned repos/Broccoli-board/zmk-workspace/zephyr/soc/native/inf_clock/Kconfig"
osource "F:/OneDrive/Desktop/cloned repos/Broccoli-board/zmk-workspace/zephyr/soc/microchip/miv/Kconfig"
osource "F:/OneDrive/Desktop/cloned repos/Broccoli-board/zmk-workspace/zephyr/soc/microchip/mec/Kconfig"
osource "F:/OneDrive/Desktop/cloned repos/Broccoli-board/zmk-workspace/zephyr/soc/mediatek/mt8xxx/Kconfig"
osource "F:/OneDrive/Desktop/cloned repos/Broccoli-board/zmk-workspace/zephyr/soc/lowrisc/opentitan/Kconfig"
osource "F:/OneDrive/Desktop/cloned repos/Broccoli-board/zmk-workspace/zephyr/soc/litex/litex_vexriscv/Kconfig"
osource "F:/OneDrive/Desktop/cloned repos/Broccoli-board/zmk-workspace/zephyr/soc/ite/ec/Kconfig"
osource "F:/OneDrive/Desktop/cloned repos/Broccoli-board/zmk-workspace/zephyr/soc/intel/raptor_lake/Kconfig"
osource "F:/OneDrive/Desktop/cloned repos/Broccoli-board/zmk-workspace/zephyr/soc/intel/lakemont/Kconfig"
osource "F:/OneDrive/Desktop/cloned repos/Broccoli-board/zmk-workspace/zephyr/soc/intel/intel_socfpga_std/Kconfig"
osource "F:/OneDrive/Desktop/cloned repos/Broccoli-board/zmk-workspace/zephyr/soc/intel/intel_socfpga/Kconfig"
osource "F:/OneDrive/Desktop/cloned repos/Broccoli-board/zmk-workspace/zephyr/soc/intel/intel_niosv/Kconfig"
osource "F:/OneDrive/Desktop/cloned repos/Broccoli-board/zmk-workspace/zephyr/soc/intel/intel_ish/Kconfig"
osource "F:/OneDrive/Desktop/cloned repos/Broccoli-board/zmk-workspace/zephyr/soc/intel/intel_adsp/Kconfig"
osource "F:/OneDrive/Desktop/cloned repos/Broccoli-board/zmk-workspace/zephyr/soc/intel/elkhart_lake/Kconfig"
osource "F:/OneDrive/Desktop/cloned repos/Broccoli-board/zmk-workspace/zephyr/soc/intel/atom/Kconfig"
osource "F:/OneDrive/Desktop/cloned repos/Broccoli-board/zmk-workspace/zephyr/soc/intel/apollo_lake/Kconfig"
osource "F:/OneDrive/Desktop/cloned repos/Broccoli-board/zmk-workspace/zephyr/soc/intel/alder_lake/Kconfig"
osource "F:/OneDrive/Desktop/cloned repos/Broccoli-board/zmk-workspace/zephyr/soc/infineon/cat3/Kconfig"
osource "F:/OneDrive/Desktop/cloned repos/Broccoli-board/zmk-workspace/zephyr/soc/infineon/cat1b/Kconfig"
osource "F:/OneDrive/Desktop/cloned repos/Broccoli-board/zmk-workspace/zephyr/soc/infineon/cat1a/Kconfig"
osource "F:/OneDrive/Desktop/cloned repos/Broccoli-board/zmk-workspace/zephyr/soc/gd/gd32/Kconfig"
osource "F:/OneDrive/Desktop/cloned repos/Broccoli-board/zmk-workspace/zephyr/soc/gaisler/leon3/Kconfig"
osource "F:/OneDrive/Desktop/cloned repos/Broccoli-board/zmk-workspace/zephyr/soc/gaisler/gr716a/Kconfig"
osource "F:/OneDrive/Desktop/cloned repos/Broccoli-board/zmk-workspace/zephyr/soc/espressif/Kconfig"
osource "F:/OneDrive/Desktop/cloned repos/Broccoli-board/zmk-workspace/zephyr/soc/ene/kb1200/Kconfig"
osource "F:/OneDrive/Desktop/cloned repos/Broccoli-board/zmk-workspace/zephyr/soc/efinix/sapphire/Kconfig"
osource "F:/OneDrive/Desktop/cloned repos/Broccoli-board/zmk-workspace/zephyr/soc/cdns/xtensa_sample_controller/Kconfig"
osource "F:/OneDrive/Desktop/cloned repos/Broccoli-board/zmk-workspace/zephyr/soc/cdns/sample_controller32/Kconfig"
osource "F:/OneDrive/Desktop/cloned repos/Broccoli-board/zmk-workspace/zephyr/soc/cdns/dc233c/Kconfig"
osource "F:/OneDrive/Desktop/cloned repos/Broccoli-board/zmk-workspace/zephyr/soc/brcm/bcmvk/Kconfig"
osource "F:/OneDrive/Desktop/cloned repos/Broccoli-board/zmk-workspace/zephyr/soc/brcm/bcm2712/Kconfig"
osource "F:/OneDrive/Desktop/cloned repos/Broccoli-board/zmk-workspace/zephyr/soc/brcm/bcm2711/Kconfig"
osource "F:/OneDrive/Desktop/cloned repos/Broccoli-board/zmk-workspace/zephyr/soc/atmel/sam0/Kconfig"
osource "F:/OneDrive/Desktop/cloned repos/Broccoli-board/zmk-workspace/zephyr/soc/atmel/sam/Kconfig"
osource "F:/OneDrive/Desktop/cloned repos/Broccoli-board/zmk-workspace/zephyr/soc/aspeed/Kconfig"
osource "F:/OneDrive/Desktop/cloned repos/Broccoli-board/zmk-workspace/zephyr/soc/arm/Kconfig"
osource "F:/OneDrive/Desktop/cloned repos/Broccoli-board/zmk-workspace/zephyr/soc/arm/beetle/Kconfig"
osource "F:/OneDrive/Desktop/cloned repos/Broccoli-board/zmk-workspace/zephyr/soc/antmicro/myra/Kconfig"
osource "F:/OneDrive/Desktop/cloned repos/Broccoli-board/zmk-workspace/zephyr/soc/andestech/Kconfig"
osource "F:/OneDrive/Desktop/cloned repos/Broccoli-board/zmk-workspace/zephyr/soc/amd/acp_6_0/Kconfig"
osource "F:/OneDrive/Desktop/cloned repos/Broccoli-board/zmk-workspace/zephyr/soc/ambiq/Kconfig"
osource "F:/OneDrive/Desktop/cloned repos/Broccoli-board/zmk-workspace/zephyr/soc/altr/zephyr_nios2f/Kconfig"
osource "F:/OneDrive/Desktop/cloned repos/Broccoli-board/zmk-workspace/zephyr/soc/altr/qemu_nios2/Kconfig"
osource "F:/OneDrive/Desktop/cloned repos/Broccoli-board/zmk-workspace/zephyr/soc/adi/max32/Kconfig"
```
